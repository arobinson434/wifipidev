## Config.in
```kconfig
source "$BR2_EXTERNAL_WiFiPiDev_PATH/package/SSD1306_OLED_RPI/Config.in"
source "$BR2_EXTERNAL_WiFiPiDev_PATH/package/i2c_ipstat/Config.in"
```

## package/SSD1306_OLED_RPI/Config.in
```kconfig
config BR2_PACKAGE_SSD1306_OLED_RPI
	bool "SSD1306_OLED_RPI"
	depends on BR2_arm
	select BR2_PACKAGE_BCM2835
	help
	  Library to support the I2C 128x64 OLED Display Module
	  driven by the SSD1306 controller for the Raspberry Pi.

	  https://github.com/gavinlyonsrepo/SSD1306_OLED_RPI
```

## package/i2c_ipstat/Config.in
```kconfig
config BR2_PACKAGE_I2C_IPSTAT
	bool "i2c_ipstat"
	depends on BR2_arm
	select BR2_PACKAGE_BCM2835
	select BR2_PACKAGE_SSD1306_OLED_RPI
	help
	  Application to grab the system's IP and display it on
	  an OLED display driven by the SSD1306 controller on a
	  Raspberry Pi.

	  https://github.com/arobinson434/i2c_ipstat
```
